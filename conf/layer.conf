## conf/layer.conf
```bitbake
# We have a conf and classes directory, add to BBPATH
BBPATH .= ":${LAYERDIR}"

# We have recipes-* directories, add to BBFILES
BBFILES += "${LAYERDIR}/recipes-*/*/*.bb \
            ${LAYERDIR}/recipes-*/*/*.bbappend \
"

BBFILE_COLLECTIONS += "techlab-kernel-backport"
BBFILE_PATTERN_techlab-kernel-backport = "^${LAYERDIR}/"
BBFILE_PRIORITY_techlab-kernel-backport = "6"

LAYERSERIES_COMPAT_techlab-kernel-backport = "zeus"
```
